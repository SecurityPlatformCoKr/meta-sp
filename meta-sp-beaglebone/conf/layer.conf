## meta-sp-beaglebone/conf/layer.conf
```bitbake
BBPATH := "${BBPATH}:${LAYERDIR}"

BBFILES := "${BBFILES} \
            ${LAYERDIR}/recipes-*/*/*.bb \
            ${LAYERDIR}/recipes-*/*/*.bbappend \
            "

BBFILE_COLLECTIONS += "sp-bbb"
BBFILE_PATTERN_sp-bbb := "^${LAYERDIR}/"
BBFILE_PRIORITY_sp-bbb = "5"

LAYERDEPENDS_sp-bbb = "sp "
```

## meta-sp-beaglebone/contrib/signed-firmware/sign.its
```
/dts-v1/;

/ {
	description = "Beaglebone black";
	#address-cells = <1>;

	images {
		kernel@1 {
			data = /incbin/("Image.lzo");
			type = "kernel";
			arch = "arm";
			os = "linux";
			compression = "lzo";
			load = <0x80008000>;
			entry = <0x80008000>;
			hash@1 {
				algo = "sha1";
			};
		};
		fdt@1 {
			description = "beaglebone-black";
			data = /incbin/("am335x-boneblack.dtb");
			type = "flat_dt";
			arch = "arm";
			compression = "none";
			hash@1 {
				algo = "sha1";
			};
		};
	};
	configurations {
		default = "conf@1";
		conf@1 {
			kernel = "kernel@1";
			fdt = "fdt@1";
			signature@1 {
				algo = "sha1,rsa2048";
				key-name-hint = "dev";
				sign-images = "fdt", "kernel";
			};
		};
	};
};
```

## meta-sp-edison/conf/distro/poky-edison-sp.conf
```bitbake
require conf/distro/poky-edison.conf

DISTRO = "poky-edison-sp"
DISTRO_FEATURES += " pam"
```

## meta-sp-edison/conf/layer.conf
```bitbake
BBPATH := "${BBPATH}:${LAYERDIR}"

BBFILES := "${BBFILES} \
            ${LAYERDIR}/recipes-*/*/*.bb \
            ${LAYERDIR}/recipes-*/*/*.bbappend \
            "

BBFILE_COLLECTIONS += "sp-edison"
BBFILE_PATTERN_sp-edison := "^${LAYERDIR}/"
BBFILE_PRIORITY_sp-edison = "5"

LAYERDEPENDS_sp-edison = "sp "
```

## meta-sp-edison/utils/sign/sign.its
```
/dts-v1/;

/ {
        description = "Intel Edison";
        #address-cells = <1>;

        images {
                kernel@1 {
			description = "Linux kernel";
                        data = /incbin/("vmlinux.lzma");
                        type = "kernel";
                        arch = "x86";
                        os = "linux";
                        compression = "lzma";
                        load  = <0x01000000>;
                        entry = <0x00000000>;
                        hash@1 {
                                algo = "sha1";
                        };
                };

		setup@1 {
			description = "Linux setup.bin";
			data = /incbin/("./setup.bin");
			type = "x86_setup";
			arch = "x86";
			os = "linux";
			compression = "none";
			load = <0x00090000>;
			entry = <0x00090000>;
			hash@2 {
				algo = "sha1";
			};
		};

                fdt@1 {
                        description = "intel-edison dtb";
                        data = /incbin/("dt.dtb");
                        type = "flat_dt";
                        arch = "x86";
                        compression = "none";
                        hash@1 {
                                algo = "sha1";
                        };
                };
        };
        configurations {
                default = "conf@1";
                conf@1 {
                        kernel = "kernel@1";
			setup = "setup@1";
                        fdt = "fdt@1";
                        signature@1 {
                                algo = "sha1,rsa2048";
                                key-name-hint = "dev";
                                sign-images = "fdt", "kernel", "setup";
                        };
                };
        };
};
```

## meta-sp-galileo/conf/layer.conf
```bitbake
BBPATH := "${BBPATH}:${LAYERDIR}"

BBFILES := "${BBFILES} \
            ${LAYERDIR}/recipes-*/*/*.bb \
            ${LAYERDIR}/recipes-*/*/*.bbappend \
            "

BBFILE_COLLECTIONS += "sp-galileo"
BBFILE_PATTERN_sp-galileo := "^${LAYERDIR}/"
BBFILE_PRIORITY_sp-galileo = "5"

LAYERDEPENDS_sp-galileo = "sp "
```

## meta-sp-raspberrypi/conf/distro/poky-raspberrypi2.conf
```bitbake
require conf/distro/poky.conf
DISTRO = "poky-raspberrypi2"

PREFERRED_PROVIDER_virtual/kernel ?= "linux-yocto"
PREFERRED_VERSION_linux-raspberrypi = "4.4%"
#PREFERRED_PROVIDER_virtual/bootloader ?=  "u-boot"
PREFERRED_VERSION_u-boot ?= "v2016.05"
#PREFERRED_VERSION_u-boot-fw-utils ?= "2014.07-1"
PREFERRED_VERSION_connman ?= "1.30"
PREFERRED_VERSION_openssl ?= "1.0.2h"
PREFERRED_VERSION_systemd ?= "225+gitAUTOINC+e1439a1472"

DISTRO_FEATURES = "ima systemd pam alsa argp bluetooth ext2 largefile usbgadget usbhost wifi xattr nfs zeroconf pci ${DISTRO_FEATURES_LIBC}"

# Disable sysvinit for recipes with systemd support
DISTRO_FEATURES_BACKFILL_CONSIDERED += "sysvinit"
VIRTUAL-RUNTIME_initscripts = ""
VIRTUAL-RUNTIME_init_manager = "systemd"
# Uncomment to completely disable support for sysv scripts:
PACKAGECONFIG_pn-systemd = "xz"
```

## meta-sp-raspberrypi/conf/layer.conf
```bitbake
BBPATH := "${BBPATH}:${LAYERDIR}"

BBFILES := "${BBFILES} \
            ${LAYERDIR}/recipes-*/*/*.bb \
            ${LAYERDIR}/recipes-*/*/*.bbappend \
            "

BBFILE_COLLECTIONS += "sp-rpi"
BBFILE_PATTERN_sp-rpi := "^${LAYERDIR}/"
BBFILE_PRIORITY_sp-rpi = "5"

LAYERDEPENDS_sp-rpi = "sp "
```

## meta-sp-raspberrypi/utils/sign/sign-rpi2.its
```
/dts-v1/;

/ {
	description = "Raspberry PI 2";
	#address-cells = <1>;

	images {
		kernel@1 {
			data = /incbin/("zImage");
			type = "kernel";
			arch = "arm";
			os = "linux";
			compression = "none";
			load  = <0x00200000>;
			entry = <0x00200000>;
			hash@1 {
				algo = "sha1";
			};
		};
		fdt@1 {
			description = "raspberry pi with infineon";
			data = /incbin/("rpi-tpm.dtb");
			type = "flat_dt";
			arch = "arm";
			compression = "none";
			hash@1 {
				algo = "sha1";
			};
		};
	};
	configurations {
		default = "conf@1";
		conf@1 {
			kernel = "kernel@1";
			fdt = "fdt@1";
			signature@1 {
				algo = "sha1,rsa2048";
				key-name-hint = "dev";
				sign-images = "fdt", "kernel";
			};
		};
	};
};
```

## meta-sp/conf/layer.conf
```bitbake
BBPATH := "${BBPATH}:${LAYERDIR}"

BBFILES := "${BBFILES} \
            ${LAYERDIR}/recipes-*/*/*.bb \
            ${LAYERDIR}/recipes-*/*/*.bbappend \
            "

BBFILE_COLLECTIONS += "sp"
BBFILE_PATTERN_sp := "^${LAYERDIR}/"
BBFILE_PRIORITY_sp = "5"

LAYERDEPENDS_sp = "core "
```
